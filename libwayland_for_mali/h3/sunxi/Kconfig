## libwayland_for_mali/h3/sunxi/Kconfig
```kconfig
config DRM_SUNXI
	tristate "DRM Support for AllwinnerTec SoC SUNXI Series"
	depends on DRM
	select DRM_KMS_HELPER
	select FB_CFB_FILLRECT
	select FB_CFB_COPYAREA
	select FB_CFB_IMAGEBLIT
	select VT_HW_CONSOLE_BINDING if FRAMEBUFFER_CONSOLE
	help
	  Choose this option if you have a allwinner SoC SUNXI chipset.
	  If M is selected the module will be called SUNXIdrm.
```
